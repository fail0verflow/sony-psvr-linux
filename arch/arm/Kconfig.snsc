## arch/arm/Kconfig.snsc
```kconfig
#
# SNSC related configurations
#

config SNSC_DEBUG_STACK_USAGE
	bool "Enable kernel stack utilization"
	depends on SNSC
	select DEBUG_STACK_USAGE
	default n
	help
	  Enables the display of the minimum amount of free stack for each
	  task in /proc/kstack. Data of exited processes are recorded to
	  memory.

config SNSC_CORRECT_PMD_CALCULATION_WHEN_AFE_IS_ENABLED
       bool "Correct pmd calculation when CONFIG_CPU_AFE==y"
       depends on CPU_AFE
       default y
       help

         If CONFIG_CPU_AFE==y, pmd calculation is wrong in
         alloc_init_section() (called by create_mapping()), which may
         produce wrong page tale entries when the size of memory chunk
         passed to it is below 4M.

config SNSC_ARM_DMA_REDUCE_CACHE_OPS
	bool "Reduce cache operations for large DMA buffer"
	depends on CPU_V7
	select SNSC_ARM_DMA_REDUCE_CACHE_OPS_UP if !SMP
	select SNSC_ARM_DMA_REDUCE_CACHE_OPS_SMP if SMP
	default n
	help
	  For the large DMA buffers which are in excess of cache size,
	  the maintenance operations by MVA are very slow. For such
	  buffers, enabling this speed up the maintenance operations
	  by using the set/way based method.

config SNSC_ARM_DMA_REDUCE_CACHE_OPS_UP
	bool

config SNSC_ARM_DMA_REDUCE_CACHE_OPS_SMP
	bool

config SNSC_ARM_DMA_REDUCE_CACHE_OPS_THRESHOLD
	int "Threshold to clean/flush whole cache"
	depends on SNSC_ARM_DMA_REDUCE_CACHE_OPS_SMP
	default 0
	help
	  Threshold to clean/flush whole cache. If set to 0, actual
	  cache size is used. Note that because clean/flush for whole
	  cache by this feature takes quite a overhead, the threshold
	  should be larger than cache size.

config SNSC_ARM_DMA_SKIP_OUTER_CACHE_OPS_FOR_OUTER_NONCACHEABLE_REGION
	bool "Skip outer cache operations for outer noncacheable DMA region"
	depends on CPU_V7
	depends on OUTER_CACHE
	default n
	help
	  Outer cache operations like clean, invalidate, and
	  clean+invalidate for outer noncacheable DMA region are
	  useless. For such regions, enabling this speed up the
	  maintenance operations by skipping useless cache operations.

config SNSC_L2X0_OPTIMIZE_RANGE_INVALIDATION
	bool "Optimize L2x0 range invalidation"
	depends on CACHE_L2X0
	default n
	help
	  For the big buffers which are in excess of cache size, the
	  maintaince operations by PA are very slow. For such buffers
	  the maintainace operations can be speeded up by using the
	  WAY based method.

config SNSC_ARM_ALLOW_TO_USE_ALL_HW_WATCHPOINTS
	bool "Allow to use all hardware watchpoints"
	depends on HAVE_HW_BREAKPOINT
	default n
	help
	  Enabling this, you can use all hardware watchpoints. But
	  there are 2 limitations because of the hardware
	  specification. First, you have to register the same overflow
	  handler for each watchpoint. Second, if you set 2 or more
	  watchpoints to different addresses, NULL is passed to
	  overflow handler as a watchpoint trigger address

config SNSC_ARM_HW_WATCHPOINT_ADDR_MASK_SUPPORT
	bool "Hardware watchpoint address mask support"
	depends on HAVE_HW_BREAKPOINT
	default n
	help
	  Enabling this allows you to set address range mask to
	  hardware watchpoint through ptrace(PTRACE_SETHBPREGS).

config SNSC_DEBUG_COUNT_TLB_FLUSH
	bool "Count number of TLB flushes"
	depends on CPU_V7
	default n
	help
	  Warning!!! Only enable this config for debugging purpose
	  as it may lead to purformance degradation. With this you
	  can read the nunmber of TLB flushes in the /proc/stat
```

## arch/arm/mach-berlin/Kconfig
```kconfig
config ARCH_BERLIN
	bool "Marvell Berlin SoCs" if ARCH_MULTI_V7
	select ARCH_HAS_CPUFREQ
	select ARCH_HAS_OPP
	select ARCH_REQUIRE_GPIOLIB
	select ARM_GIC
	select COMMON_CLK
	select CPU_V7
	select DW_APB_ICTL
	select DW_APB_TIMER_OF
	select GENERIC_CLOCKEVENTS
	select GENERIC_IRQ_CHIP
	select MIGHT_HAVE_CACHE_L2X0
	select HAVE_ARM_SCU
	select HAVE_SMP
	select HAVE_ARM_TWD if LOCAL_TIMERS
	select LOCAL_TIMERS if SMP
	select MIGHT_HAVE_PCI
	select SPARSE_IRQ
	select USB_ARCH_HAS_EHCI if USB_SUPPORT
	select USE_OF

if ARCH_BERLIN

menu "Marvell Berlin SoCs Support"

comment "BERLIN modules"

config BERLIN_SM
	bool "Support SM CPU"
	default n
	help
	  Enable support for SM(System Manager) which is designed for front
	  panel control and power management.

config BERLIN_IR
	bool "Support Infra-Red remote controlle"
	depends on BERLIN_SM
	default n
	help
	  Enable support for Infra-Red remote controller

config BERLIN_PXA3XX_NFC
	tristate "Support NAND Flash Controller (fork of pxa3xx_nand)"
	default n
	help
	  A fork of mainline pxa3xx_nand.c. This NFC has no dedicated interrupt, but SoC
	  contains a powerfull pbridge DMA engine whose interrupt can be enabled/disabled.
	  So the driver could work in 3 modes: nonDMA, polling-DMA, interrupt-DMA.

config BERLIN_NAND_RANDOMIZER
	bool "Support software NAND randomizer"
	default y
	depends on BERLIN_PXA3XX_NFC
	help
	  To improve data stability for some large-capacity MLC(multipil-level cell) chips,
	  data have to be randomized before storing into, or
	  derandomized after reading out, from the physical cells.
	  For chips that don't build in HW randomizer, SW randomizer is needed.
	  Say Y here if you have no idea

config BERLIN_NAND_READ_RETRY
	bool "Support NAND read retry when ecc fail in read operation"
	default y
	depends on BERLIN_PXA3XX_NFC
	help
	  To improve nand read ability of error correction.When ecc fail in read operation,
	  change the read cmd parameter of nand chip. Every kind of Nand chip's READ RETRY feature
	  diff from each other.If nand chip do not support READ RETRY, this feature will do nothin.
	  Now support hynix nand chip read retry.

config BERLIN_GPU
	tristate "SoC's GPU support"
	default m
	help
	  2D and 3D GPU support

config BERLIN_SDIO_BT_CHAR_8777
	tristate "SDIO Bluetooth char device for bt8777 module"
	default n
	depends on MMC_SDHCI_MV
	help
	  This is the bt char module for Berlin. Please try build it for module only.

config BERLIN_SDIO_WLAN_8777
	tristate "SDIO Wlan (IEEE802.11 A|B|G|N) driver for wlan8777 module"
	default n
	depends on MMC_SDHCI_MV
	help
	  This is the wifi module for Berlin. Please try build it for module only.

config BERLIN_SDIO_WLAN_8801
	tristate "SDIO Wlan (IEEE802.11 A|B|G|N) driver for wlan8801 module"
	default n
	depends on MMC_SDHCI_MV
	help
	  This is the wifi module for Berlin. Please try build it for module only.

config BERLIN_SDIO_WLAN_8897
	tristate "SDIO Wlan (IEEE802.11 A|B|G|N) driver for wlan8897 module"
	default n
	depends on MMC_SDHCI_MV
	select WIRELESS_EXT
	select WEXT_PRIV
	select WEXT_SPY
	help
	  This is the wifi module for Berlin. Please try build it for module only.

config BERLIN_SDIO_WLAN_8887
	tristate "SDIO Wlan (IEEE802.11 A|B|G|N) driver for wlan8887 module"
	default n
	depends on MMC_SDHCI_MV
	help
	  This is the wifi module for Berlin. Please try build it for module only.

config BERLIN_SDIO_BT_CHAR_8897
	tristate "SDIO Bluetooth char device for bt8897 module"
	default n
	depends on MMC_SDHCI_MV
	select WIRELESS_EXT
	select WEXT_PRIV
	select WEXT_SPY
	help
	  This is the bt char module for Berlin. Please try build it for module only.

config BERLIN_SDIO_BT_CHAR_8887
	tristate "SDIO Bluetooth char device for bt8887 module"
	default n
	depends on MMC_SDHCI_MV
	help
	  This is the bt char module for Berlin. Please try build it for module only.

config BERLIN_USB_WLAN_8897
	tristate "USB Wlan (IEEE802.11 A|B|G|H|N) driver for wlan8897 module"
	default n
	depends on USB
	select WIRELESS_EXT
	select WEXT_PRIV
	select WEXT_SPY
	help
	  This is the wifi module for Berlin. Please try build it for module only.

config BERLIN_USB_BT_CHAR_8897
	tristate "BT char driver for usb8897 module"
	default n
	depends on USB
	help
	  This is the BT char drvier for Berlin. Please try build it for module only.

config BERLIN_USB_WLAN_8797
	tristate "USB Wlan (IEEE802.11 A|B|G|H|N) driver for wlan8797 module"
	default n
	depends on USB
	select WIRELESS_EXT
	select WEXT_PRIV
	select WEXT_SPY
	help
	  This is the wifi module for Berlin. Please try build it for module only.

config BERLIN_USB_BT_CHAR_8797
	tristate "BT char driver for usb8797 module"
	default n
	depends on USB
	help
	  This is the BT char drvier for Berlin. Please try build it for module only.

config BERLIN_USB_FW_DNLD
	tristate "USB firmware download tool for usb8797"
	default n
	depends on USB
	select WIRELESS_EXT
	select WEXT_PRIV
	select WEXT_SPY
	help
	  This is a firmware download tool for Berlin. Please try build it for module only.

config BERLIN_RF4CE
	tristate "Support RF4CE"
	default n
	depends on SPI
	help
	  RF4CE support

config BERLIN_PWM
	bool "Support PWM"
	default n
	help
	  Enable support for PWM

endmenu

endif
```

## drivers/mmc/card/Kconfig.snsc
```kconfig
#
# SNSC related configurations
#

config SNSC_MMCQD_SCHED_OPTION
	bool 'Set scheduler policy/priority for mmcqd'
	depends on SNSC
	select SNSC_SET_THREAD_PRIORITY

config SNSC_MMCQD_SCHED_POLICY
	int 'Scheduler Policy(0=NORMAL, 1=FIFO, 2=RR)'
	depends on SNSC
	depends on SNSC_MMCQD_SCHED_OPTION
	default 2

config SNSC_MMCQD_SCHED_PRIORITY
	int 'Scheduler Priority(NORMAL:-20..19, FIFO/RR:1..99)'
	depends on SNSC
	depends on SNSC_MMCQD_SCHED_OPTION
	default 99
```

## drivers/pci/host/Kconfig
```kconfig
menu "PCI host controller drivers"
	depends on PCI

config PCI_BERLIN
	bool "Marvell Berlin PCIe controller"
	depends on ARCH_BERLIN
	depends on OF

endmenu
```

## drivers/soc/Kconfig
```kconfig
menu "SOC (System On Chip) specific Drivers"

source "drivers/soc/berlin/Kconfig"

endmenu
```

## drivers/soc/berlin/Kconfig
```kconfig
#
# berlin SoC drivers
#
config BERLIN_CHIPID
	bool "Support BERLIN CHIPID"
	default y
	select SOC_BUS
	depends on ARCH_BERLIN || ARM64
	help
	  If you say Y here you get support for the BERLIN CHIP id.
```
