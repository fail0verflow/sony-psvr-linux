## init/Kconfig.snsc
```kconfig
#
# SNSC related configurations
#

config SNSC_QEMU
	bool 'QEMU Support'
	depends on SNSC
	default n

config SNSC_QEMU_FB_CIRRUS
	bool 'QEMU Support for Cirrus Logic'
	depends on SNSC
	depends on SNSC_QEMU
	depends on FB_CIRRUS
	default n
	help
	  This enables support for Cirrus Logic GD5446 based boards on
	  QEMU.

config SNSC_QEMU_HW_WATCHPOINT_DEBUG
 	bool 'QEMU Support for Enhanced Hardware Watchpoint Debug'
 	depends on SNSC
 	depends on SNSC_QEMU
 	default n

config SNSC_NLVER_CUSTOMVER_ENABLE
	bool 'Use custom kernel version'
	depends on SNSC

config SNSC_NLVER_CUSTOMVER
	string 'Custom kernel version'
	depends on SNSC_NLVER_CUSTOMVER_ENABLE
	depends on SNSC

config SNSC_NLVER_REPOSITORYVERSION_AUTO
	bool 'Embed git/arch repository revision'
	depends on SNSC

config SNSC_NLVER_NBLVER
	bool 'Add support of NBL version'
	depends on SNSC
	depends on SNSC_NBLARGS
  	default y if ARM
	default n

config SNSC_DEFERRED_INITCALLS
	bool 'Support for deferred initcalls'
	depends on SNSC
	depends on ARM
	default n

config SNSC_DEFERRED_INITCALLS_SUBSYS
	bool 'Enable deferred initcalls for subsystem (ex. subsys_initcall())'
	depends on SNSC_DEFERRED_INITCALLS
	default n

config SNSC_DEFERRED_INITCALLS_GROUP_SUBSYS
	int 'Group number for subsystem drivers (0-31)'
	depends on SNSC_DEFERRED_INITCALLS_SUBSYS
	default 8

config SNSC_DEFERRED_INITCALLS_SCSI
	bool 'Enable deferred initcalls for SCSI'
	depends on SNSC_DEFERRED_INITCALLS
	depends on SCSI
	default n

config SNSC_DEFERRED_INITCALLS_GROUP_BLK_DEV_SD
	int 'Group number for SCSI disk driver (0-31)'
	depends on SNSC_DEFERRED_INITCALLS_SCSI
	depends on BLK_DEV_SD
	default 16

config SNSC_DEFERRED_INITCALLS_USB
	bool 'Enable deferred initcalls for USB'
	depends on SNSC_DEFERRED_INITCALLS
	depends on USB
	default n

config SNSC_DEFERRED_INITCALLS_GROUP_USB_HCD
	int 'Group number for USB Host Controller drivers (0-31)'
	depends on SNSC_DEFERRED_INITCALLS_USB
	depends on USB_EHCI_HCD || USB_OHCI_HCD
	default 16

config SNSC_DEFERRED_INITCALLS_GROUP_USB_STORAGE
	int 'Group number for USB Storage driver (0-31)'
	depends on SNSC_DEFERRED_INITCALLS_USB
	depends on USB_STORAGE
	default 16

config SNSC_DEFERRED_INITCALLS_GROUP_USB_VIDEO_CLASS
	int 'Group number for USB Video Class driver (0-31)'
	depends on SNSC_DEFERRED_INITCALLS_USB
	depends on USB_VIDEO_CLASS
	default 16

config SNSC_DEFERRED_INITCALLS_USB_GADGET
	bool 'Enable deferred initcalls for USB gadget'
	depends on SNSC_DEFERRED_INITCALLS
	depends on USB_GADGET=y
	depends on USB_GADGET_SELECTED
	default n

config SNSC_DEFERRED_INITCALLS_GROUP_USB_GADGET_CONTROLLER
	int 'Group number for USB gadget controller driver (0-31)'
	range 0 31
	default 16
	depends on SNSC_DEFERRED_INITCALLS_USB_GADGET
	help
	 The group number should not be greater than number of USB Gadget
	 functions like SNSC_DEFERRED_INITCALLS_GROUP_USB_GADGET_ETH

config SNSC_DEFERRED_INITCALLS_GROUP_USB_GADGET_ETH
	int 'Group number for USB gadget ethernent driver (0-31)'
	range 0 31
	default 16
	depends on SNSC_DEFERRED_INITCALLS_USB_GADGET
	depends on USB_ETH=y

config SNSC_DEFERRED_INITCALLS_PCI
	bool 'Enable deferred initcalls for PCI'
	depends on SNSC_DEFERRED_INITCALLS
	depends on PCI
	default n

config SNSC_DEFERRED_INITCALLS_GROUP_PCIEPORTBUS
	int 'Group number for PCI Express drivers (0-31)'
	depends on SNSC_DEFERRED_INITCALLS_PCI
	depends on PCIEPORTBUS
	default 16

config SNSC_BOOT_FORMAT
	bool "Select kernel image format"
	depends on SNSC
	default n

config SNSC_BOOT_BIN
	bool "Raw Binary"
	depends on SNSC_BOOT_FORMAT
	default n

config SNSC_BOOT_BIN_GZ
	bool "Gzipped Raw Binary"
	depends on SNSC_BOOT_FORMAT
	default n

config SNSC_BOOT_ELF
	bool "Stripped ELF"
	depends on SNSC_BOOT_FORMAT
	default n

config SNSC_BOOT_ELF_GZ
	bool "Gzipped & Stripped ELF"
	depends on SNSC_BOOT_FORMAT
	default n

config SNSC_NULL_CONSOLE
	bool 'Support for NULL console'
	depends on SNSC

config SNSC_LOOPBACK_SCHED_OPTION
	bool 'Set scheduler policy/priority for loopback device'
	depends on SNSC
	depends on BLK_DEV_LOOP
	select SNSC_SET_THREAD_PRIORITY

config SNSC_LOOPBACK_SCHED_POLICY
	int 'Scheduler Policy(0=NORMAL, 1=FIFO, 2=RR)'
	depends on SNSC
	depends on SNSC_LOOPBACK_SCHED_OPTION
	default 2

config SNSC_LOOPBACK_SCHED_PRIORITY
	int 'Scheduler Priority(NORMAL:-20..19, FIFO/RR:1..99)'
	depends on SNSC
	depends on SNSC_LOOPBACK_SCHED_OPTION
	default 99

config SNSC_KSWAPD_SCHED_OPTION
	bool 'Set scheduler policy/priority for kswapd'
	depends on SNSC
	select SNSC_SET_THREAD_PRIORITY

config SNSC_KSWAPD_SCHED_POLICY
	int 'Scheduler Policy(0=NORMAL, 1=FIFO, 2=RR)'
	depends on SNSC
	depends on SNSC_KSWAPD_SCHED_OPTION
	default 2

config SNSC_KSWAPD_SCHED_PRIORITY
	int 'Scheduler Priority(NORMAL:-20..19, FIFO/RR:1..99)'
	depends on SNSC
	depends on SNSC_KSWAPD_SCHED_OPTION
	default 99

config SNSC_KSOFTIRQD_SCHED_OPTION
	bool 'Set scheduler policy/priority for ksoftirqd'
	depends on SNSC
	select SNSC_SET_THREAD_PRIORITY

config SNSC_KSOFTIRQD_SCHED_POLICY
	int 'Scheduler Policy(0=NORMAL, 1=FIFO, 2=RR)'
	depends on SNSC
	depends on SNSC_KSOFTIRQD_SCHED_OPTION
	default 2

config SNSC_KSOFTIRQD_SCHED_PRIORITY
	int 'Scheduler Priority(NORMAL:-20..19, FIFO/RR:1..99)'
	depends on SNSC
	depends on SNSC_KSOFTIRQD_SCHED_OPTION
	default 99

config SNSC_WORKQUEUE_SCHED_OPTION
	bool 'Set scheduler policy/priority for workqueue'
	depends on SNSC
	select SNSC_SET_THREAD_PRIORITY

config SNSC_WORKQUEUE_SCHED_POLICY
	int 'Scheduler Policy(0=NORMAL, 1=FIFO, 2=RR)'
	depends on SNSC
	depends on SNSC_WORKQUEUE_SCHED_OPTION
	default 2

config SNSC_WORKQUEUE_SCHED_PRIORITY
	int 'Scheduler Priority(NORMAL:-20..19, FIFO/RR:1..99)'
	depends on SNSC
	depends on SNSC_WORKQUEUE_SCHED_OPTION
	default 99

config SNSC_BDI_SCHED_OPTION
	bool 'Set scheduler policy/priority for BDI tasks'
	depends on SNSC
	select SNSC_SET_THREAD_PRIORITY

config SNSC_BDI_SCHED_POLICY
	int 'Scheduler Policy(0=NORMAL, 1=FIFO, 2=RR)'
	depends on SNSC
	depends on SNSC_BDI_SCHED_OPTION
	default 2

config SNSC_BDI_SCHED_PRIORITY
	int 'Scheduler Priority(NORMAL:-20..19, FIFO/RR:1..99)'
	depends on SNSC
	depends on SNSC_BDI_SCHED_OPTION
	default 99

config SNSC_NBLARGS
	bool 'Use NBLArgs to pass data from bootloader to kernel'
	depends on SNSC

config SNSC_NBLARGS_RESERVE_ENTRY_REGION
	bool 'Reserve NBLArgs entry region to prevent kernel using that area.'
	depends on SNSC_NBLARGS
	default n
```

## kernel/Kconfig.snsc
```kconfig
#
# SNSC related configurations
#

config SNSC_WORKQUEUE_RESCHEDULE
	bool "Enable rescheduling in workqueue"
	depends on SNSC
	default y if SMP && !PREEMPT
	help
	  While a CPU executes CPU-bound non-sleeping work from workqueue,
	  other processors can add more works to workqueue rapidly.
	  In this case, workqueue occupy a CPU for a long time
	  and it causes soft lockup.
	  Enable this workaround to add rescheduling in run_workqueue().

config SNSC_WORKQUEUE_DEADLOCK_FIX_CHECK_CURRENT
	bool "Fix deadlock in workqueue by checking current"
	depends on SNSC
	default y
	help
	  We need the change below to fix BUG_ON in run_workqueue().
	    GIT: abbeb88d00bef294ce661a9229c1dc31be064545
	    blk_sync_queue() should cancel request_queue->unplug_work
	  But this change causes a deadlock rarely.
	  Enable this config to fix this problem.

config SNSC_SET_THREAD_PRIORITY
	bool
	depends on SNSC
	default n

config SNSC_PRINTK_CUSTOM_LOG_DRIVER
	bool "Support for printk log driver"
	depends on SNSC
	default n

config SNSC_PRINTK_EXCLUSIVE_OUTPUT
	bool "Exclusive printk output"
	depends on SNSC
	depends on SMP
	default n
	help
	  On racy condition on SMP system, it's possible that a string
	  of printk by a CPU is just stored into internal buffer, and
	  printk by another CPU actually puts it to console. In this
	  case, duration of later printk may increase, because later
	  printk have to handle a string of former printk in addition
	  to its own string. This behavior may cause some issue, for
	  example, IRQ disabled for unexpected long period. To avoid
	  such a behavior, this option ensures that each printk
	  exclusively grabs console, and puts its own string only to
	  console. Note that enabling this trade off latency of
	  printk.

config SNSC_POSIX_CLOCK_SNSC_RAW_CLOCK
	bool "POSIX clock support for snsc_raw_clock()"
	depends on SNSC
	default n
	help
	  This option enables special POSIX clock to be able to get a value
	  of snsc_raw_clock() from user space by clock_gettime() with special
	  clock ID (CLOCK_SNSC_RAW_CLOCK).
	  Note: CLOCK_SNSC_RAW_CLOCK is non-compliant with POSIX specification.

config SNSC_DEBUG_CAPABILITY
	bool "Enable no capability messages"
	depends on SNSC
	default n
	help
	  This option enables debug messages to see which capability is required.

config SNSC_DEBUG_CAPABILITY_OOPS
	bool "Enable no capability oops"
	depends on SNSC_DEBUG_CAPABILITY
	default n
	help 
	  If y, an exception happens when a required capability is not equiped.

config SNSC_DEBUG_CAPABILITY_DETAIL
	bool "Enable capability details"
	depends on SNSC_DEBUG_CAPABILITY
	default n
	help 
	  If y, print deatils about capability.

config SNSC_SCHED_RT_PERIOD_US_DEFAULT
	int "Default value of /proc/sys/kernel/sched_rt_period_us"
	default 1000000
	range 100000 2000000

config SNSC_SCHED_RT_RUNTIME_US_DEFAULT
	int "Default value of /proc/sys/kernel/sched_rt_runtime_us"
	default 950000
	range 90000 SNSC_SCHED_RT_PERIOD_US_DEFAULT
```

## lib/Kconfig.debug_snsc
```kconfig
menu "SNSC Configurations"

comment "SNSC debug options"
	depends on SNSC

config SNSC_SCHED_CLOCK_TEST
	bool  'Enable to output sched_clock() retval from /proc'
	depends on SNSC

config SNSC_ALT_BACKTRACE
	bool  'Enable alternative backtrace routine'
	depends on SNSC
	depends on ARM_UNWIND_USER
	default y

config SNSC_ALT_BACKTRACE_PROC_USTACK
	bool  'Proc entry for human-readable user-stack backtrace'
	depends on SNSC_ALT_BACKTRACE
	default y
	help
	   This option creates /proc/TGID/task/PID/ustack.  'cat' it
	   to print backtrace of userspace stack of the specified
	   task.  During backtracing, the task is stopped by ptrace.
	   Another entry /proc/TGID/task/PID/ustack_raw does not stop
	   the task but reading it while the task is running may
	   return meaningless results.

config SNSC_TRACER
	bool  'Enable Debug Tracer'
	depends on SNSC
	default y



endmenu
```

## sound/bluetooth/Kconfig
```kconfig
# ALSA BLUETOOTH drivers

menu "bluetooth sound devices"
	depends on BT

config SND_BT_AUDIO
	tristate "bluetooth alsa driver"
	select SND_HWDEP
	select SND_RAWMIDI
	select SND_PCM
	help
	  Say Y here to include support for BT audio devices.

	  To compile this driver as a module, choose M here: the module
	  will be called snd-bt-audio.
endmenu
```

## tools/em/Kconfig.snsc
```kconfig
menuconfig SNSC_EM
	tristate "Support for SNSC Exception Monitor"
	select EXCEPTION_MONITOR

if SNSC_EM

config SNSC_EM_LOG_DRIVER
	bool "Support for Log Driver"
	default n

config SNSC_EM_LOGFILE_MAX_SIZE
	int "log file max size"
	depends on SNSC_EM_LOG_DRIVER
	default 229376

config SNSC_EM_LOGFILE_ACCEPTABLE_LINE_BYTES
	int "max size for each line"
	depends on SNSC_EM_LOG_DRIVER
	default 1023

config SNSC_EM_LOGFILE_LOG_MAX_LINES
	int "max line counts got from log buffer"
	depends on SNSC_EM_LOG_DRIVER
	default 2048

config SNSC_EM_USER_HOOK
	bool "Support for user hook"
	default n

config SNSC_EM_USER_HOOK_FILENAME
	string "usermode file called after exception"
	depends on SNSC_EM_USER_HOOK
	default ""

config SNSC_EM_USER_HOOK_FILENAME_PATH
	string "path when running usermode file"
	depends on SNSC_EM_USER_HOOK
	default ""

config SNSC_EM_VERSION_FILE
	bool "Support for software version file to dump"
	default n

config SNSC_EM_VERSION_FILENAME
	string "software version file name"
	depends on SNSC_EM_VERSION_FILE
	default ""

config SNSC_EM_NOTIFY
	bool "Support for notify function"
	default n

config SNSC_EM_NOTIFY_ENTER
	bool "Support for notifing ENTER"
	depends on SNSC_EM_NOTIFY
	default n

config SNSC_EM_USERMODE_CALLBACK
	bool "Support for usermode callback"
	depends on ARM
	default y

config SNSC_EM_ATOMIC_CALLBACK
	bool "Support for atomic callback"
	default y

config SNSC_EM_CALLSTACK_ENABLE
	bool "Support for getting backtrace with kernel backtrace routine"
	default y

config SNSC_EM_CALLSTACK
	string "Callstack options"
	depends on SNSC_EM_CALLSTACK_ENABLE
	default "kstack,kstack_regs,ustack"

config SNSC_EM_PREEMPT_DISABLE
	bool "Disable kernel preemption while in interaction mode"
	default n

config SNSC_EM_USE_CONSOLE_WRITE
	bool "Use console_write instread of printk for console output"
	default y

config SNSC_EM_DEMANGLE
	bool "Support for C++ symbol demangle"
	default n

config SNSC_EM_DISASSEMBLE
	bool "Support for disassemble"
	default n

config SNSC_EM_CONSOLE_IRQ_DISABLE
	bool "Disable Console IRQ while in interaction mode"
	default n

config SNSC_EM_CONSOLE_IRQ
	int "Console IRQ number disabled while in interaction mode"
	depends on SNSC_EM_CONSOLE_IRQ_DISABLE

config SNSC_EM_INTERACT_ENABLE
	bool "Enable interaction mode"
	default y

config SNSC_EM_INTERACT
	string
	default "on" if SNSC_EM_INTERACT_ENABLE
	default "off" if !SNSC_EM_INTERACT_ENABLE

config SNSC_EM_MAX_SHARED_LIBRARIES
	int "Max number of shared library loaded for symbol search"
	default "20"

config SNSC_EM_LOGFILENAME
	string "Log file name"
	default "/root/exception.txt"

config SNSC_EM_RESET_WATCHDOG
	bool "Reset watchdog at entering exception monitor"
	default n

if SNSC_EM_RESET_WATCHDOG
config SNSC_EM_RESET_WATCHDOG_DEADLINE
	int "A parameter to pass to watchdog"
	default 13
	range 11 15
	help
	  A value to specify the watchdog interval. 
	  11 means 5 seconds, 12 means 10 seconds, and 15 means 80 seconds.
endif

config SNSC_EM_PRINT_INFO_EXTERNAL
	bool "Print exception info to external via registered function"
	default n

if SNSC_EM_PRINT_INFO_EXTERNAL

config SNSC_EM_PRINT_INFO_EXTERNAL_ALWAYS
	bool "Print exception info unconditionally"
	default n

config SNSC_EM_PRINT_INFO_EXTERNAL_ZLIB
	tristate "Zlib compression for external print"
	select ZLIB_DEFLATE
	help
	  Compresses the printed data

endif

choice
	prompt "Output of an initial dump"
	default SNSC_EM_INITDUMP_BOTH

config SNSC_EM_INITDUMP_CONSOLE
	bool "Console"

config SNSC_EM_INITDUMP_FILE
	bool "File"

config SNSC_EM_INITDUMP_NOLOG
	bool "Console and File"

config SNSC_EM_INITDUMP_BOTH
	bool "Console and File with LOG Driver"

config SNSC_EM_INITDUMP_NONE
	bool "None"

endchoice

config SNSC_EM_INITDUMP
	string
	default "console" if SNSC_EM_INITDUMP_CONSOLE
	default "file" if SNSC_EM_INITDUMP_FILE
	default "nolog" if SNSC_EM_INITDUMP_NOLOG
	default "both" if SNSC_EM_INITDUMP_BOTH
	default "none" if SNSC_EM_INITDUMP_NONE

config SNSC_EM_REBOOT_FLAG
	bool "Reboot the system when Exception Monitor dumps all the info"
	default n

config SNSC_EM_REBOOT
	string
	default "on" if SNSC_EM_REBOOT_FLAG
	default "off" if !SNSC_EM_REBOOT_FLAG

# architecture selection
config SNSC_EM_ARM
	bool
	default y if ARM
	default n

config SNSC_EM_MIPS
	bool
	default y if MIPS
	default n

config SNSC_EM_PPC
	bool
	default y if PPC
	default n

config SNSC_EM_I686
	bool
	default y if X86
	default n

endif # SNSC_EM
```
